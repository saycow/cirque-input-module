## dts/bindings/input/cirque,pinnacle-spi-legacy.yaml
```yaml
description: |
  Sensor driver for the Cirque Pinnacle trackpad ASICs, using the SPI interface

compatible: "cirque,pinnacle-legacy"

include: ["spi-device.yaml", "cirque,pinnacle-common.yaml"]
```
